## compiler-rt/Kconfig.L4
```kconfig
menu "Compiler runtime"
config COMPILER_RT_LIBGCC_SHARED
        bool "Use shared libgcc"
        depends on !COMPILER_RT_USE_TOOLCHAIN_LIBGCC
        help
          Say Y if you want to use shared libgcc (libgcc_s.so).

config COMPILER_RT_USE_TOOLCHAIN_LIBGCC
        bool "Use libgcc from toolchain"
        default y
        help
          Say Y if you want to use the libgcc shipped with your toolchain
          instead of the one built specifically for L4Re.

# Sparc and PPC32 cannot be build from source.
config COMPILER_RT_FALLBACK
        def_bool BUILD_ARCH = "sparc" || BUILD_ARCH = "ppc32"
        select COMPILER_RT_USE_TOOLCHAIN_LIBGCC
endmenu
```

## l4re/Kconfig.L4
```kconfig
menu "L4Re"

config L4RE_CAP_DFL_ALLOCATOR_MAX
	int "Maximum number of default allocator cap slots"
	default 4096 if MMU
	default 64 if !MMU
	help
	  The allocation of capability slots is managed in lib4re. It requires
	  static storage proportional to the number of supported allocations.

choice
	prompt "Capability allocator"
	default L4RE_COUNTING_CAP_ALLOC

config L4RE_COUNTING_CAP_ALLOC
	bool "Reference counters"
	help
	  Reference counting allocator for capability slots.

	  This is the default allocator. Should not be changed except for
	  feature and resource constrained systems.

config L4RE_BITMAP_CAP_ALLOC
	bool "Bitmap allocator"
	help
	  Simple bitmap allocator for capability slots.

	  Attention: any code that uses reference counted capabilites (e.g.
	  L4Re::Util::Shared_cap) will lead to capability leaks because
	  reference counting is not possible. Only use it on small systems
	  without dynamic workloads.

endchoice

config L4RE_REGION_INFO
	bool "Enable additional region information"
	default y
	help
	  Enable functionality for additional information for regions in the
	  address space.

	  Disabling this option will lead to a reduced debugging experience.

endmenu
```

## ldscripts/Kconfig.L4
```kconfig
config BID_CAN_STATIC_HEAP
	bool
	default y if BUILD_ARCH_arm || BUILD_ARCH_arm64
```

## sigma0/Kconfig.L4
```kconfig
menu "Sigma0 (root pager)"
	visible if EXPERT

config SIGMA0_PRIORITY
	int "Priority"
	range 1 255
	default 255
	help
	  This sets the priority the root pager runs with. The default
	  is the highest priority and is almost always the best fit.

	  Valid values range from 1 to 255.

endmenu
```
