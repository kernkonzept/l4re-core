## libc/Kconfig.L4
```kconfig
choice
  prompt "Libc variant"
  default L4_LIBC_MUSL

config L4_LIBC_UCLIBC
  bool "uclibc-ng (deprecated)"

config L4_LIBC_MUSL
  bool "musl"

endchoice

config L4_LIBC
  string
  default "uclibc-ng" if L4_LIBC_UCLIBC
  default "musl" if L4_LIBC_MUSL
```

## moe/Kconfig.L4
```kconfig
menu "Moe"
	visible if EXPERT

config MOE_DEBUG_NAMES
	bool "Set jdb names for created kernel objects"
	help
	  With this option enabled, Moe will register names in jdb for all
	  objects it creates.

	  This is a debugging and development feature.

config MOE_BOOT_FB
	bool "Pass-on the bootloader's frame buffer"
	default y
	help
	  Add support to expose the bootloader's frame buffer as special
	  dataspace.

	  If unsure, say y.

endmenu
```
